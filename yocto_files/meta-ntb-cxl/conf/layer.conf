## yocto_files/meta-ntb-cxl/conf/layer.conf
```bitbake
# We have a conf and classes directory, add to BBPATH
BBPATH .= ":${LAYERDIR}"

# We have recipes-* directories, add to BBFILES
BBFILES += "${LAYERDIR}/recipes-*/*/*.bb \
            ${LAYERDIR}/recipes-*/*/*.bbappend"

BBFILE_COLLECTIONS += "meta-ntb-cxl"
BBFILE_PATTERN_meta-ntb-cxl = "^${LAYERDIR}/"
BBFILE_PRIORITY_meta-ntb-cxl = "6"

LAYERDEPENDS_meta-ntb-cxl = "core"
LAYERSERIES_COMPAT_meta-ntb-cxl = "kirkstone langdale"

MACHINE_ESSENTIAL_EXTRA_RDEPENDS += "kernel-module-ntrdma"
```
